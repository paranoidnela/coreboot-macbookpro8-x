## src/mainboard/apple/macbookpro8_1/Kconfig
```kconfig
if BOARD_APPLE_MACBOOKPRO8_1

config BOARD_SPECIFIC_OPTIONS
	def_bool y
	select BOARD_ROMSIZE_KB_8192
	select EC_ACPI
	select HAVE_ACPI_RESUME
	select HAVE_ACPI_TABLES
	select INTEL_INT15
	select NORTHBRIDGE_INTEL_SANDYBRIDGE
	select SERIRQ_CONTINUOUS_MODE
	select SOUTHBRIDGE_INTEL_BD82X6X
	select SYSTEM_TYPE_LAPTOP
	select USE_NATIVE_RAMINIT
	select MAINBOARD_HAS_LIBGFXINIT
	select HAVE_CMOS_DEFAULT
	select HAVE_OPTION_TABLE

config MAINBOARD_DIR
	default "apple/macbookpro8_1"

config MAINBOARD_PART_NUMBER
	default "MacBookPro8,2"

config VGA_BIOS_FILE
	string
	default "pci8086,0116.rom"

config VGA_BIOS_ID
	string
	default "8086,0116"

config DRAM_RESET_GATE_GPIO
	int
	default 28

config MAX_CPUS
	int
	default 8
endif
```
